// SPDX-License-Identifier: (GPL-2.0+ OR MIT)
/*
 * Copyright (c) 2022 veye.cc
 *
 */

 /dts-v1/;

#include "rk3566-roc-pc.dtsi"
/*
 *                               Select one of the three 
 * using single camera xc7160 ----> rk3566-roc-pc-cam-8ms1m.dtsi
 * using dual camera gc2053/gc2093   ----> rk3566-roc-pc-cam-2ms2m.dtsi
 * using veye camera 2m              --->  rk3566-roc-pc-cam-veyecam2m.dtsi
 */
//#include "rk3566-roc-pc-cam-8ms1m.dtsi"
//#include "rk3566-roc-pc-cam-2ms2m.dtsi"
#include "rk3566-roc-pc-cam-veyecam2m.dtsi"

/ {
    model = "ROC-RK3566-PC HDMI(Android)";
    compatible = "rockchip,rk3566-roc-pc", "rockchip,rk3566";
};

&route_hdmi {
	status = "okay";
	connect = <&vp0_out_hdmi>;
};
