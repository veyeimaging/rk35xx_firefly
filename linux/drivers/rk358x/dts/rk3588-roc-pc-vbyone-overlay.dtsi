// SPDX-License-Identifier: GPL-2.0-only
// Definitions for VEYE IMAGING's V-by-ONE
/*
 * Copyright (c) 2023 www.veye.cc
 *
 */

&i2c7{
    veye_vbyone: vbyone@65 {
    compatible = "veye,vbyone";
    priority = <(-1)>;
    reg = <0x65>;
    status = "okay";
    csi-lane-count = <2>;
    coax-num = <1>;
    cam-i2c-pt-setting = <0x13>;
    camera-i2c-address=<0x3b>;
    
    trgin-gpio-mode = <0>;
    out1-gpio-mode = <0>;
    out2-gpio-mode = <0>;
    
    serializer {
        i2c-address=<0x34>;
        csi-lane-count = <2>;
        csi-lane-speed = <1500>;
        };
    };

};
